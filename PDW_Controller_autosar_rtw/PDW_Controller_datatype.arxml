AUTOSAR XML (schema 00049)
standard types defined: Float, Boolean, UInt8, float32, boolean, uint8
package /DataTypes/CompuMethods
  compu method COMPU_Boolean: 0=FALSE, 1=TRUE
package /DataTypes/SwAddrMethods
  sw addr method CODE: section-type=CODE
  sw addr method CONST: section-type=CONST
  sw addr method VAR: section-type=VAR
package /DataTypes/Units
  unit NoUnit: factor-si-to-unit=1, offset-si-to-unit=0
