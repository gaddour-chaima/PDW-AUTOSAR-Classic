AUTOSAR XML (schema 00049)
package /Components/SwcImplementations
  swc implementation PDW_Controller_Impl: programming-language=C, sw-version=1.32.1, used-code-generator=Embedded Coder 7.9 (R2022b) 13-May-2022, vendor-id=0, behavior=PDW_Controller_IB
    code-descriptors:
      code Code
        artifact-descriptors:
          short-label=PDW_Controller_c, category=SWSRC
          short-label=PDW_Controller_h, category=SWHDR
          short-label=PDW_Controller_private_h, category=SWHDR
          short-label=PDW_Controller_types_h, category=SWHDR
          short-label=rtwtypes_h, category=SWHDR
    resource consumption RsrcCons_PDW_Controller
