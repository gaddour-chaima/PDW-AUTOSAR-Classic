AUTOSAR XML (schema 00049)
package /Interfaces
  4 x sender receiver interface:
    DistanceInput
      data DistanceInput: category=VALUE, sw-calibration-access=READ-ONLY, type=Float
    ReverseGearInput
      data ReverseGearInput: category=VALUE, sw-calibration-access=READ-ONLY, type=Boolean
    WarningLevelOutput
      data WarningLevelOutput: category=VALUE, sw-calibration-access=READ-ONLY, type=UInt8
    BuzzerOutput
      data BuzzerOutput: category=VALUE, sw-calibration-access=READ-ONLY, type=Boolean
